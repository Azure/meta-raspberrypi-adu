## conf/layer.conf
```bitbake
BBPATH .= ":${LAYERDIR}"

# We have a recipes directory containing .bb and .bbappend files, add to BBFILES
BBFILES += "${LAYERDIR}/recipes*/*/*.bb \
            ${LAYERDIR}/recipes*/*/*.bbappend"

BBFILE_COLLECTIONS += "raspberrypi-adu"
BBFILE_PATTERN_raspberrypi-adu := "^${LAYERDIR}/"

# Pri 17 ensures that our recipes are applied over other layers.
# This is applicable where we are using appends files to adjust other recipes.
BBFILE_PRIORITY_raspberrypi-adu = "17"
LAYERDEPENDS_raspberrypi-adu = "swupdate"

LAYERSERIES_COMPAT_raspberrypi-adu  = "kirkstone"

# Layer-specific configuration variables.
# These values can/will be overriden by environment variables
# if those variables are added to the BB_ENV_PASSTHROUGH_ADDITIONS environment variable.

# HW_REV will be written to a file that is used by the swupdate
# to determine hardware compatibility.
HW_REV ?= "1.0"

# ADUC_PRIVATE_KEY is the build host path to the .pem private key file to use to sign the image.
# ADUC_PRIVATE_KEY_PASSWORD is the build host path to the .pass password file for the private key.

BBFILES += "${@' '.join('${LAYERDIR}/%s/recipes*/*/*.%s' % (layer, ext) \
               for layer in '${BBFILE_COLLECTIONS}'.split() for ext in ['bb', 'bbappend'])}"

# Image level user/group configuration.
# Inherit extrausers to make the setting of EXTRA_USERS_PARAMS effective.
INHERIT += "extrausers"

# User / group settings
# The settings are separated by the ; character.
# Each setting is actually a command. The supported commands are useradd,
# groupadd, userdel, groupdel, usermod and groupmod.
EXTRA_USERS_PARAMS = "groupadd --gid 800 adu ; \
 groupadd -r --gid 801 do ; \
 useradd --uid 800 -p '' -r -g adu --no-create-home --shell /bin/false adu ; \
 useradd --uid 801 -p '' -r -g do -G adu --no-create-home --shell /bin/false do ; \
 "
```
